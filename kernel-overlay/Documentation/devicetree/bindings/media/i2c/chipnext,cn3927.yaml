## kernel-overlay/Documentation/devicetree/bindings/media/i2c/chipnext,cn3927.yaml
```yaml
# SPDX-License-Identifier: GPL-2.0-only OR BSD-2-Clause
%YAML 1.2
---
$id: http://devicetree.org/schemas/media/i2c/chipnext,cn3927.yaml#
$schema: http://devicetree.org/meta-schemas/core.yaml#

title: Chipnext CN3927 camera voice coil lens driver

maintainers:
  - Cheng Fangming <chengfangming1993@gmail.com>

description:
  The CN3927 is a 10-bit DAC with current sink capability intended for
  driving voice coil lenses in camera modules.

properties:
  compatible:
    const: chipnext,cn3927

  reg:
    maxItems: 1

  vcc-supply:
    description: VDD power supply

  vio-supply:
    description: I/O and I2C pull-up power supply

required:
  - compatible
  - reg
  - vcc-supply
  - vio-supply

additionalProperties: false

examples:
  - |
    i2c {
        #address-cells = <1>;
        #size-cells = <0>;

        lens@c {
            compatible = "chipnext,cn3927";
            reg = <0x0c>;
            vio-supply = <&camera_vio_1v8>;
            vcc-supply = <&camera_vcm_2v8>;
        };
    };
...
```

## kernel-overlay/Documentation/devicetree/bindings/media/i2c/ovti,ov13b10.yaml
```yaml
# SPDX-License-Identifier: (GPL-2.0-only OR BSD-2-Clause)
%YAML 1.2
---
$id: http://devicetree.org/schemas/media/i2c/ovti,ov13b10.yaml#
$schema: http://devicetree.org/meta-schemas/core.yaml#

title: OmniVision OV13B10 CMOS Sensor

maintainers:
  - Hao Yao <hao.yao@intel.com>

description: |
  The OmniVision OV13B10 is a 13-megapixel CMOS image sensor. It is
  controlled through I2C and transmits 10-bit Bayer images over a two- or
  four-lane MIPI CSI-2 interface.

allOf:
  - $ref: /schemas/media/video-interface-devices.yaml#

properties:
  compatible:
    const: ovti,ov13b10

  reg:
    maxItems: 1

  clocks:
    maxItems: 1

  clock-names:
    items:
      - const: xvclk

  clock-frequency:
    const: 19200000

  avdd-supply:
    description: Analog power supply.

  dovdd-supply:
    description: Digital I/O power supply.

  dvdd-supply:
    description: Digital core power supply.

  reset-gpios:
    description: Active-low XSHUTDOWN signal.
    maxItems: 1

  orientation: true

  rotation: true

  port:
    $ref: /schemas/graph.yaml#/$defs/port-base
    additionalProperties: false

    properties:
      endpoint:
        $ref: /schemas/media/video-interfaces.yaml#
        unevaluatedProperties: false

        properties:
          data-lanes:
            oneOf:
              - items:
                  - const: 1
                  - const: 2
              - items:
                  - const: 1
                  - const: 2
                  - const: 3
                  - const: 4

          link-frequencies:
            items:
              - const: 560000000

        required:
          - data-lanes
          - link-frequencies

    required:
      - endpoint

required:
  - compatible
  - reg
  - clocks
  - clock-frequency
  - avdd-supply
  - dovdd-supply
  - dvdd-supply
  - reset-gpios
  - port

unevaluatedProperties: false

examples:
  - |
    #include <dt-bindings/gpio/gpio.h>

    i2c {
        #address-cells = <1>;
        #size-cells = <0>;

        camera@36 {
            compatible = "ovti,ov13b10";
            reg = <0x36>;

            clocks = <&camcc 0>;
            clock-names = "xvclk";
            clock-frequency = <19200000>;

            avdd-supply = <&camera_avdd>;
            dovdd-supply = <&camera_dovdd>;
            dvdd-supply = <&camera_dvdd>;
            reset-gpios = <&gpio 28 GPIO_ACTIVE_LOW>;

            port {
                endpoint {
                    data-lanes = <1 2 3 4>;
                    link-frequencies = /bits/ 64 <560000000>;
                };
            };
        };
    };
...
```
